## firmware/ost4ml5b32a/boards/shields/stokerjack/Kconfig.defconfig
```kconfig
if SHIELD_STOKERJACK_60 || SHIELD_STOKERJACK_58
config ZMK_KEYBOARD_NAME
    default "Stokerjack"
endif
```

## firmware/ost4ml5b32a/boards/te9no/stokerjack/stokerjack_defconfig
```kconfig
CONFIG_GPIO=y
CONFIG_SPI=n
CONFIG_LED_STRIP=y
CONFIG_PM_DEVICE=y
CONFIG_PM_DEVICE_RUNTIME=n
CONFIG_ARM_MPU=y
CONFIG_HW_STACK_PROTECTION=y
CONFIG_CLOCK_CONTROL_NRF_K32SRC_RC=y
CONFIG_CLOCK_CONTROL_NRF_K32SRC_500PPM=y
CONFIG_BUILD_OUTPUT_HEX=y
CONFIG_USE_DT_CODE_PARTITION=y
CONFIG_USE_SEGGER_RTT=y
CONFIG_LOG=y
CONFIG_LOG_BACKEND_RTT=y
CONFIG_LOG_BACKEND_UART=n
CONFIG_CONSOLE=y
CONFIG_RTT_CONSOLE=y
CONFIG_UART_CONSOLE=n
CONFIG_BUILD_OUTPUT_UF2=y
```

## firmware/ost4ml5b32a/config/west.yml
```yaml
manifest:
  remotes:
    - name: cormoran
      url-base: https://github.com/cormoran
  projects:
    - name: zmk
      remote: cormoran
      revision: e5c9b6915b56801193e359dd9bad4a167ce0d1b8
      import: app/west.yml
    - name: zmk-feature-cdc-acm-bootloader-trigger
      url: https://github.com/te9no/zmk-feature-cdc-acm-bootloader-trigger
      revision: 1850754d269aab9ba73e4639371bfe59a4130e65
      path: modules/zmk-feature-cdc-acm-bootloader-trigger
    - name: zmk-feature-custom-settings
      url: https://github.com/cormoran/zmk-feature-custom-settings
      revision: c6a7fef3a3be3d3ace5de9a4b0628c6418cd1f3f
      path: zmk-feature-custom-settings
    - name: zmk-feature-runtime-combo
      url: https://github.com/cormoran/zmk-feature-runtime-combo
      revision: d9490e7b5d41c516221d131241009e81740efcee
      path: modules/zmk-feature-runtime-combo
    - name: zmk-feature-runtime-macro
      url: https://github.com/cormoran/zmk-feature-runtime-macro
      revision: 38530962eb7061b60efcb98e84585cfb1f0cb6de
      path: modules/zmk-feature-runtime-macro
    - name: zmk-module-ble-management
      url: https://github.com/cormoran/zmk-module-ble-management
      revision: 57738cc4fc6ba80e82a7ac57741a0339cb186cd4
      path: modules/zmk-module-ble-management
    - name: zmk-module-settings-rpc
      url: https://github.com/te9no/zmk-module-settings-rpc
      revision: 083a299dd8d31c275809c5a249b12486be24a7d2
      path: modules/zmk-module-settings-rpc
    - name: zmk-feature-device-info
      url: https://github.com/cormoran/zmk-feature-device-info
      revision: 8cedd2dd9f04e19ea5a17b94914dd47a09d8db11
      path: modules/zmk-feature-device-info
    - name: zmk-feature-watchdog
      url: https://github.com/cormoran/zmk-feature-watchdog
      revision: 84ad14c6c3645dc40b23f45d08ab45418655f912
      path: modules/zmk-feature-watchdog
    - name: zmk-feature-kscan-diagnostics
      url: https://github.com/cormoran/zmk-feature-kscan-diagnostics
      revision: 1432f7fe0cfe903cd7d3c9931ae6bd6f2e1f328e
      path: modules/zmk-feature-kscan-diagnostics
    - name: zmk-module-devtool
      url: https://github.com/cormoran/zmk-module-devtool
      revision: 9938a2c73c06d6e65ba2c0b68c9aa044a467eafc
      path: modules/zmk-module-devtool
  self:
    path: config/zmk-keyboard-Stokerjack
```

## firmware/ost4ml5b32a/dts/bindings/behaviors/te9no,stokerjack-led.yaml
```yaml
description: Stokerjack safe switched RGB power toggle
compatible: "te9no,stokerjack-led"
include: zero_param.yaml
```

## firmware/status-led/boards/shields/stokerjack/Kconfig.shield
```kconfig
config SHIELD_STOKERJACK_60
    def_bool $(shields_list_contains,stokerjack_60)
config SHIELD_STOKERJACK_58
    def_bool $(shields_list_contains,stokerjack_58)
```
