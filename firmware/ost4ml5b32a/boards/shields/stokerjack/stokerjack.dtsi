#include <dt-bindings/zmk/matrix_transform.h>
#include <physical_layouts.dtsi>
/ {
    chosen {
        zmk,kscan = &kscan0;
        zmk,physical-layout = &physical_layout0;
    };
    kscan0: kscan {
        compatible = "zmk,kscan-gpio-matrix";
        diode-direction = "col2row";
        row-gpios =
            <&gpio0 2 (GPIO_ACTIVE_HIGH | GPIO_PULL_DOWN)>,
            <&gpio0 3 (GPIO_ACTIVE_HIGH | GPIO_PULL_DOWN)>,
            <&gpio0 4 (GPIO_ACTIVE_HIGH | GPIO_PULL_DOWN)>,
            <&gpio0 5 (GPIO_ACTIVE_HIGH | GPIO_PULL_DOWN)>,
            <&gpio0 6 (GPIO_ACTIVE_HIGH | GPIO_PULL_DOWN)>,
            <&gpio0 7 (GPIO_ACTIVE_HIGH | GPIO_PULL_DOWN)>;
        col-gpios =
            <&gpio0 8 GPIO_ACTIVE_HIGH>,
            <&gpio0 11 GPIO_ACTIVE_HIGH>,
            <&gpio0 12 GPIO_ACTIVE_HIGH>,
            <&gpio0 13 GPIO_ACTIVE_HIGH>,
            <&gpio0 14 GPIO_ACTIVE_HIGH>,
            <&gpio0 15 GPIO_ACTIVE_HIGH>,
            <&gpio0 16 GPIO_ACTIVE_HIGH>,
            <&gpio0 17 GPIO_ACTIVE_HIGH>,
            <&gpio0 19 GPIO_ACTIVE_HIGH>,
            <&gpio0 20 GPIO_ACTIVE_HIGH>;
    };
};
