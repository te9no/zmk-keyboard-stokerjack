#include <common/nordic/nrf52840_uf2_boot_mode.dtsi>

/ {
    cdc_boot: cdc_boot {
        compatible = "zmk,cdc-acm-bootloader-trigger";
        cdc-port = <&snippet_zmk_usb_logging_uart>;
    };
};
